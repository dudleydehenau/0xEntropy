#include "Screen_app.h"
#include "pico/stdlib.h"
#include <stdio.h>
#include "../../Entropy/entropy.h"
#include <stdbool.h>
#include <string.h>

extern bool intro_sound_enabled;
extern bool always_on;
extern float ui_entropie;
extern float ui_ratio_bits_1;
extern uint32_t ui_debit_o_s;

// MATRICES PIXEL ART

const char* design_logo_entropy[8] = {
    " 000        EEEEE         t                         ",
    "0   0       E             t                         ",
    "0  00 x   x E     nnnn  ttttt rrrr   ooo  pppp  y  y",
    "0 0 0  x x  EEEE  n   n   t   r   r o   o p   p y  y",
    "00  0   x   E     n   n   t   r     o   o p   p y  y",
    "0   0  x x  E     n   n   t   r     o   o pppp   yyy",
    " 000  x   x EEEEE n   n    t  r      ooo  p        y",
    "                                          p      yy "
};

const char* design_logo_settings[5] = {
    " SSSS  EEEEE TTTTT TTTTT I N   N  GGGG  SSSS ",
    "S      E       T     T   I NN  N G     S     ",
    " SSS   EEEE    T     T   I N N N G  GG  SSS  ",
    "    S  E       T     T   I N  NN G   G     S ",
    "SSSS   EEEEE   T     T   I N   N  GGGG SSSS  "
};

const unsigned char Uptime[] = {
	0xff, 0xff, 0xff, 0xff, 0xff, 0xff, 0xff, 0xff, 0xff, 0xff, 0xff, 0xff, 0xff, 0xff, 0xff, 0xff, 
	0xff, 0xff, 0xff, 0xff, 0xff, 0xff, 0xff, 0xff, 0xff, 0xff, 0xff, 0xff, 0xff, 0xff, 0xfc, 0x00, 
	0x00, 0x00, 0x3f, 0xfc, 0x00, 0x00, 0x00, 0x3f, 0xff, 0x3f, 0xff, 0xfc, 0xff, 0xff, 0x3f, 0xff, 
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	0xff, 0xff, 0xff, 0xff, 0xff, 0xff, 0xff, 0xff
};

const unsigned char Ratio[] = {
	0xff, 0xff, 0xff, 0xff, 0xff, 0xff, 0xff, 0xff, 0xff, 0xff, 0xff, 0xff, 0xff, 0xff, 0xff, 0xff, 
	0xff, 0xff, 0xff, 0xff, 0xff, 0xff, 0xff, 0xff, 0xff, 0xff, 0xff, 0xff, 0xff, 0xff, 0xff, 0xff, 
	0xff, 0x8f, 0xff, 0xff, 0xff, 0xff, 0x8f, 0xff, 0xff, 0xf0, 0xff, 0x0f, 0xff, 0xff, 0xe0, 0x7f, 
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	0xff, 0xff, 0xff, 0xff, 0xff, 0xff, 0xff, 0xff
};

const unsigned char Health[] = {
	0xff, 0xff, 0xff, 0xff, 0xff, 0xff, 0xff, 0xff, 0xff, 0xff, 0xff, 0xff, 0xff, 0xff, 0xff, 0xff, 
	0xff, 0xff, 0xff, 0xff, 0xff, 0xff, 0xff, 0xff, 0xff, 0xff, 0xff, 0xff, 0xff, 0xff, 0xff, 0xff, 
	0xff, 0xff, 0xff, 0xff, 0xe0, 0x7e, 0x07, 0xff, 0xff, 0xe0, 0x7e, 0x07, 0xff, 0xff, 0x9f, 0x99, 
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	0xff, 0xff, 0xff, 0xff, 0xff, 0xff, 0xff, 0xff
};

const unsigned char Bitrate[] = {
	0xff, 0xff, 0xff, 0xff, 0xff, 0xff, 0xff, 0xff, 0xff, 0xff, 0xff, 0xff, 0xff, 0xff, 0xff, 0xff, 
	0xff, 0xff, 0xff, 0xff, 0xff, 0xff, 0xff, 0xff, 0xff, 0xff, 0xff, 0xff, 0xff, 0xff, 0xff, 0xff, 
	0xff, 0xff, 0xff, 0xff, 0xff, 0xff, 0xff, 0xff, 0xff, 0xff, 0xff, 0xff, 0xff, 0xff, 0xff, 0x80, 
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	0xff, 0xff, 0xff, 0xff, 0xff, 0xff, 0xff, 0xff
};

const unsigned char Settings[] = {
	0xff, 0xff, 0xff, 0xff, 0xff, 0xff, 0xff, 0xff, 0xff, 0xff, 0xff, 0xff, 0xff, 0xff, 0xff, 0xff, 
	0xff, 0xff, 0xff, 0xff, 0xff, 0xff, 0xff, 0xff, 0xff, 0xff, 0xff, 0xff, 0xff, 0xff, 0xff, 0x1f, 
	0xff, 0xff, 0xff, 0xff, 0x1f, 0xff, 0xff, 0xff, 0xf3, 0x18, 0x00, 0x00, 0x0f, 0xf3, 0x18, 0x00, 
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	0xff, 0xff, 0xff, 0xff, 0xff, 0xff, 0xff, 0xff
};

const unsigned char Arrow[] = {
	0xff, 0xff, 0xff, 0xff, 0xff, 0xff, 0xff, 0xff, 0xff, 0xff, 0xff, 0xff, 0xff, 0xff, 0xff, 0xff, 
	0xff, 0xff, 0xff, 0xff, 0xff, 0xff, 0xff, 0xff, 0xff, 0xff, 0xff, 0xff, 0xff, 0xff, 0xff, 0xff, 
	0xff, 0xff, 0xff, 0xff, 0xff, 0xff, 0xff, 0xff, 0xff, 0xff, 0xff, 0xff, 0xff, 0xff, 0xff, 0xff, 
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	0xff, 0xff, 0xff, 0xff, 0xff, 0xff, 0xff, 0xff
};

const unsigned char Lune[]  = {
	0xff, 0xff, 0xff, 0xff, 0xff, 0xff, 0xff, 0xff, 0xff, 0xff, 0xff, 0xff, 0xff, 0xff, 0xff, 0xff, 
	0xff, 0xff, 0xff, 0xff, 0xff, 0xff, 0xff, 0xff, 0xff, 0xff, 0xff, 0x83, 0xff, 0xff, 0xff, 0xfc, 
	0x77, 0xff, 0xff, 0xff, 0xfb, 0xcf, 0xff, 0xff, 0xff, 0xe7, 0xbf, 0xff, 0xff, 0xff, 0xdf, 0x7f, 
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	0xff, 0xff, 0xff, 0xff, 0xff, 0xff, 0xff, 0xff
};

const unsigned char Lunebarre [] = {
	0xff, 0xff, 0xff, 0xff, 0xff, 0xff, 0xff, 0xff, 0xff, 0xff, 0xff, 0xff, 0xff, 0xff, 0xff, 0xff, 
	0xff, 0xff, 0xff, 0xff, 0xff, 0xff, 0xff, 0xff, 0xff, 0xff, 0xff, 0x83, 0xff, 0xff, 0xff, 0xfc, 
	0x77, 0xff, 0xff, 0xff, 0xfb, 0xcf, 0xff, 0xff, 0xff, 0xe7, 0xbf, 0xff, 0xff, 0xff, 0xdf, 0x7f, 
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	0xff, 0xff, 0xff, 0xff, 0xff, 0xff, 0xff, 0xff
};

const unsigned char Qrcode[] = {
	0xff, 0xff, 0xff, 0xff, 0xff, 0xff, 0xff, 0xff, 0xff, 0xff, 0xff, 0xff, 0xf0, 0xff, 0xff, 0xff, 
	0xff, 0xff, 0xff, 0xff, 0xff, 0xff, 0xff, 0xff, 0xff, 0xf0, 0xff, 0xff, 0xff, 0xff, 0xff, 0xff, 
	0xff, 0xff, 0xff, 0xff, 0xff, 0xff, 0xf0, 0xe0, 0x00, 0x00, 0x07, 0x80, 0x70, 0x0f, 0xe1, 0xfe, 
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	0xff, 0xff, 0xff, 0xf0
};

const unsigned char Qrcodefatal[] = {
	0xff, 0xff, 0xff, 0xff, 0xff, 0xff, 0xff, 0xff, 0xff, 0xff, 0xff, 0xff, 0xf0, 0x80, 0x00, 0x00, 
	0x7e, 0x1c, 0x7f, 0xfe, 0x3c, 0x0f, 0xe0, 0x00, 0x00, 0x10, 0x80, 0x00, 0x00, 0x7e, 0x1c, 0x3f, 
	0xfe, 0x3c, 0x07, 0xe0, 0x00, 0x00, 0x10, 0x80, 0x00, 0x00, 0x7e, 0x1c, 0x3f, 0xfe, 0x3c, 0x07, 
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	0xff, 0xff, 0xff, 0xf0
};
// fonctions pour le dessin

void dessiner_rectangle_arrondi(uint16_t x1, uint16_t y1, uint16_t x2, uint16_t y2, uint16_t rayon, uint16_t couleur) {
    // on trace deux rectangles croisés et des cercles aux coins pour l'effet arrondi
    Paint_DrawRectangle(x1 + rayon, y1, x2 - rayon, y2 + 1, couleur, DRAW_FILL_FULL, DOT_PIXEL_1X1);
    Paint_DrawRectangle(x1, y1 + rayon, x2 + 1, y2 - rayon, couleur, DRAW_FILL_FULL, DOT_PIXEL_1X1);
    Paint_DrawCircle(x1 + rayon, y1 + rayon, rayon, couleur, DRAW_FILL_FULL, DOT_PIXEL_1X1); 
    Paint_DrawCircle(x2 - rayon, y1 + rayon, rayon, couleur, DRAW_FILL_FULL, DOT_PIXEL_1X1); 
    Paint_DrawCircle(x1 + rayon, y2 - rayon, rayon, couleur, DRAW_FILL_FULL, DOT_PIXEL_1X1); 
    Paint_DrawCircle(x2 - rayon, y2 - rayon, rayon, couleur, DRAW_FILL_FULL, DOT_PIXEL_1X1); 
}

void dessiner_rectangle_arrondi_creux(uint16_t x1, uint16_t y1, uint16_t x2, uint16_t y2, uint16_t rayon, uint16_t epaisseur, uint16_t couleur) {
    // on dessine le fond puis on vide le milieu avec un rectangle noir
    dessiner_rectangle_arrondi(x1, y1, x2, y2, rayon, couleur);
    dessiner_rectangle_arrondi(x1 + epaisseur, y1 + epaisseur, x2 - epaisseur, y2 - epaisseur, 
                               (rayon > epaisseur) ? (rayon - epaisseur) : 1, BLACK);
}

void dessiner_barre_pilule(uint16_t x, uint16_t y, uint16_t largeur, uint16_t hauteur, uint8_t pourcentage, uint16_t couleur_gauche, uint16_t couleur_droite) {
    uint16_t epaisseur_bord = 1; 
    uint16_t couleur_contour = DARK_GRAY; 

    if (pourcentage > 100) pourcentage = 100;

    // calcul des dimensions du contour
    uint16_t x_contour = x - 1;              
    uint16_t y_contour = y;                  
    uint16_t x2_contour = x + largeur;       
    uint16_t y2_contour = y + hauteur - 1;   

    uint16_t w_contour = x2_contour - x_contour;
    uint16_t h_contour = y2_contour - y_contour;
    uint16_t rayon_contour = h_contour / 2;

    dessiner_rectangle_arrondi_creux(x_contour, y_contour, x2_contour, y2_contour, rayon_contour, epaisseur_bord, couleur_contour);

    // zone de remplissage a l'interieur
    uint16_t marge = epaisseur_bord + 1; 
    uint16_t x_in = x_contour + marge;
    uint16_t y_in = y_contour + marge;
    uint16_t w_in = w_contour - (marge * 2);
    uint16_t h_in = h_contour - (marge * 2);

    uint16_t largeur_remplissage = (w_in * pourcentage) / 100;
    uint16_t r_in = h_in / 2; 

    // on dessine la barre pixel par pixel pour bien gerer l'arrondi
    for (uint16_t i = 0; i < w_in; i++) {
        uint16_t dx = 0; 
        if (i < r_in) {
            dx = r_in - 1 - i; 
        } else if (i >= w_in - r_in) {
            dx = i - (w_in - r_in);
        }

        uint16_t max_dy = 0;
        while ((dx * dx + (max_dy + 1) * (max_dy + 1)) <= (r_in * r_in)) {
            max_dy++;
        }

        uint16_t decalage_y = r_in - max_dy;
        uint16_t couleur_ligne = (i < largeur_remplissage) ? couleur_gauche : couleur_droite;

        uint16_t y_start = y_in + decalage_y;
        uint16_t y_end = y_in + h_in - 1 - decalage_y;

        if (y_start <= y_end) {
            Paint_DrawLine(x_in + i, y_start, x_in + i, y_end, couleur_ligne, DOT_PIXEL_1X1, LINE_STYLE_SOLID);
        }
    }
}

void dessiner_icone_40x40(uint16_t x, uint16_t y, const unsigned char* bitmap, uint16_t couleur_icone) {
    // affichage d'une icone bitmap simple
    uint8_t octets_par_ligne = 5; 
    for (uint16_t j = 0; j < 40; j++) {         
        for (uint16_t i = 0; i < 40; i++) {     
            uint16_t index_octet = (j * octets_par_ligne) + (i / 8);
            uint8_t bit_index = 7 - (i % 8);    
            if ((bitmap[index_octet] & (1 << bit_index)) == 0) {
                Paint_SetPixel(x + i, y + j, couleur_icone);
            }
        }
    }
}

void dessiner_qrcode_100x100(uint16_t x, uint16_t y, const unsigned char* bitmap) {
    // rendu du QR code
    uint8_t octets_par_ligne = 13; 

    for (uint16_t j = 0; j < 100; j++) {
        for (uint16_t i = 0; i < 100; i++) {
            uint16_t index_octet = (j * octets_par_ligne) + (i / 8);
            uint8_t bit_index = 7 - (i % 8);    

            if ((bitmap[index_octet] & (1 << bit_index)) == 0) {
                Paint_SetPixel(x + i, y + j, BLACK);
            } else {
                Paint_SetPixel(x + i, y + j, WHITE);
            }
        }
    }
}

void dessiner_fond_grille(uint16_t largeur_ecran, uint16_t hauteur_ecran) {
    // petit quadrillage de fond pour le style
    Paint_DrawRectangle(0, 0, largeur_ecran, hauteur_ecran, BLACK, DRAW_FILL_FULL, DOT_PIXEL_1X1);
    uint16_t espacement = 12;
    for (uint16_t x = 0; x < largeur_ecran; x += espacement) {
        Paint_DrawLine(x, 0, x, hauteur_ecran, DARK_GRAY, DOT_PIXEL_1X1, LINE_STYLE_SOLID);
    }
    for (uint16_t y = 0; y < hauteur_ecran; y += espacement) {
        Paint_DrawLine(0, y, largeur_ecran, y, DARK_GRAY, DOT_PIXEL_1X1, LINE_STYLE_SOLID);
    }
}

void dessiner_logo_entropy(uint16_t largeur_ecran, uint16_t hauteur_ecran) {
    // le logo fait avec des petits cubes
    dessiner_fond_grille(largeur_ecran, hauteur_ecran);
    uint16_t lignes = 8, colonnes = 52, taille_cube = 3, taille_gap = 1;
    uint16_t pas = taille_cube + taille_gap;
    uint16_t start_x = (largeur_ecran - (colonnes * pas)) / 2;
    uint16_t start_y = (hauteur_ecran - (lignes * pas)) / 2;

    for (uint16_t y = 0; y < lignes; y++) {
        for (uint16_t x = 0; x < colonnes; x++) {
            if (design_logo_entropy[y][x] != ' ') {
                uint16_t px = start_x + (x * pas);
                uint16_t py = start_y + (y * pas);
                Paint_DrawRectangle(px, py, px + pas - 1, py + pas - 1, BLACK, DRAW_FILL_FULL, DOT_PIXEL_1X1);
                Paint_DrawRectangle(px, py, px + taille_cube - 1, py + taille_cube - 1, WHITE, DRAW_FILL_FULL, DOT_PIXEL_1X1);
            }
        }
    }
}

void dessiner_entete_dashboard(uint16_t largeur_ecran, uint16_t hauteur_ecran) {
    // header du dashboard principal
    dessiner_fond_grille(largeur_ecran, hauteur_ecran);
    uint16_t lignes = 8, colonnes = 52, taille_cube = 2, taille_gap = 1;
    uint16_t pas = taille_cube + taille_gap;
    uint16_t start_x = (largeur_ecran - (colonnes * pas)) / 2;
    uint16_t start_y = 15;

    for (uint16_t y = 0; y < lignes; y++) {
        for (uint16_t x = 0; x < colonnes; x++) {
            if (design_logo_entropy[y][x] != ' ') {
                uint16_t px = start_x + (x * pas);
                uint16_t py = start_y + (y * pas);
                Paint_DrawRectangle(px, py, px + pas - 1, py + pas - 1, BLACK, DRAW_FILL_FULL, DOT_PIXEL_1X1);
                Paint_DrawRectangle(px, py, px + taille_cube - 1, py + taille_cube - 1, WHITE, DRAW_FILL_FULL, DOT_PIXEL_1X1);
            }
        }
    }
}

void dessiner_entete_settings(uint16_t largeur_ecran, uint16_t hauteur_ecran) {
    // header pour la page reglages
    dessiner_fond_grille(largeur_ecran, hauteur_ecran);
    uint16_t colonnes = 45, lignes = 5, taille_cube = 2, taille_gap = 1;
    uint16_t pas = taille_cube + taille_gap;
    uint16_t start_x = ((largeur_ecran - (colonnes * pas)) / 2) + 3;
    uint16_t start_y = 15;

    for (uint16_t y = 0; y < lignes; y++) {
        for (uint16_t x = 0; x < colonnes; x++) {
            if (design_logo_settings[y][x] != ' ') {
                uint16_t px = start_x + (x * pas);
                uint16_t py = start_y + (y * pas);
                Paint_DrawRectangle(px, py, px + pas - 1, py + pas - 1, BLACK, DRAW_FILL_FULL, DOT_PIXEL_1X1);
                Paint_DrawRectangle(px, py, px + taille_cube - 1, py + taille_cube - 1, WHITE, DRAW_FILL_FULL, DOT_PIXEL_1X1);
            }
        }
    }
}

void dessiner_page_dashboard(UWORD *BlackImage) {
    dessiner_entete_dashboard(240, 280);

    uint16_t marge_x = 10, hauteur_box = 36, espace_y = 8, espace_x = 5, start_y = 55; 
    uint16_t x1_carre = marge_x, x2_carre = x1_carre + hauteur_box;
    uint16_t x1_rect = x2_carre + espace_x, x2_rect = 240 - marge_x; 
    uint16_t epaisseur_bord = 1, rayon_bord = 5;

    // bloc 1 : affichage du ratio

    uint16_t y1 = start_y;
    dessiner_rectangle_arrondi_creux(x1_carre, y1, x2_carre, y1 + hauteur_box, rayon_bord, epaisseur_bord, COLOR_BOX_GREEN);
    dessiner_icone_40x40(x1_carre - 2, y1 - 2, Ratio, WHITE);
    dessiner_rectangle_arrondi_creux(x1_rect, y1, x2_rect, y1 + hauteur_box, rayon_bord, epaisseur_bord, COLOR_BOX_GREEN);

    uint16_t health_percent_1 = (uint16_t)(ui_ratio_bits_1 + 0.5f); 
    if(health_percent_1 > 100) health_percent_1 = 100;
    uint16_t health_percent_0 = 100 - health_percent_1;

    char texte_0[10], texte_1[10];
    sprintf(texte_0, "%d%%", health_percent_0);
    sprintf(texte_1, "%d%%", health_percent_1);

    uint16_t hauteur_barre = 20; 
    uint16_t y_barre = y1 + ((hauteur_box - hauteur_barre) / 2); 
    Paint_DrawString_EN(x1_rect + 6, y1 + 12, texte_0, &Font12, BLACK, WHITE);

    uint16_t decalage_gauche = 34, decalage_droite = 34; 
    uint16_t x_barre = x1_rect + decalage_gauche;
    uint16_t largeur_barre = (x2_rect - x1_rect) - decalage_gauche - decalage_droite; 
    uint8_t tolerance = 4; 
    uint16_t couleur_0, couleur_1;

    // change la couleur si on s'eloigne trop du 50/50
    if (health_percent_0 < (50 - tolerance) || health_percent_0 > (50 + tolerance)) {
        couleur_0 = COLOR_BAR_RED; couleur_1 = COLOR_BAR_RED_FLASH; 
    } else {
        couleur_0 = COLOR_BAR_GREEN; couleur_1 = COLOR_BOX_BLUE;
    }

    dessiner_barre_pilule(x_barre, y_barre, largeur_barre, hauteur_barre, health_percent_0, couleur_0, couleur_1);
    Paint_DrawString_EN(x_barre + largeur_barre + 4, y1 + 12, texte_1, &Font12, BLACK, WHITE);

    // bloc 2 : debit de donnees

    uint16_t y2 = y1 + hauteur_box + espace_y;

    // icone a gauche
    dessiner_rectangle_arrondi_creux(x1_carre, y2, x2_carre, y2 + hauteur_box, rayon_bord, epaisseur_bord, COLOR_BOX_PINK);
    dessiner_icone_40x40(x1_carre - 2, y2 - 2, Bitrate, WHITE); 

    // boite pour la valeur
    dessiner_rectangle_arrondi_creux(x1_rect, y2, x2_rect, y2 + hauteur_box, rayon_bord, epaisseur_bord, COLOR_BOX_PINK);

    // conversion du debit
    float debit_kbit_s = ((float)ui_debit_o_s * 8.0f) / 1000.0f; 
    char texte_valeur[16];
    sprintf(texte_valeur, "%.1f", debit_kbit_s);

    // on met le chiffre en gros
    Paint_DrawString_EN(x1_rect + 16, y2 + 10, texte_valeur, &Font20, BLACK, WHITE);

    // et l'unite juste a cote
    uint16_t x_kbps = (x1_rect + 12) + (strlen(texte_valeur) * 14) + 4; 
    Paint_DrawString_EN(x_kbps, y2 + 18, "kbps", &Font12, BLACK, WHITE);

    // petite zone pour le ratio TRNG
    uint16_t largeur_ratio = 36;
    uint16_t hauteur_ratio = 20;

    // place a 5 px du bord droit
    uint16_t x1_ratio = x2_rect - largeur_ratio - 5; 
    uint16_t y1_ratio = y2 + (hauteur_box - hauteur_ratio) / 2; 

    dessiner_rectangle_arrondi_creux(x1_ratio, y1_ratio, x1_ratio + largeur_ratio, y1_ratio + hauteur_ratio, 3, 1, COLOR_BOX_PINK);

    char texte_ratio[10];
    sprintf(texte_ratio, "%d:1", trng_ratio); 

    // on centre le texte a la main
    uint16_t txt_ratio_w = strlen(texte_ratio) * 7;
    uint16_t x_txt_ratio = x1_ratio + (largeur_ratio - txt_ratio_w) / 2;
    uint16_t y_txt_ratio = y1_ratio + (hauteur_ratio - 12) / 2;

    Paint_DrawString_EN(x_txt_ratio, y_txt_ratio, texte_ratio, &Font12, BLACK, WHITE);

    // bloc 3 : temps d'activite (uptime)

    uint16_t y3 = y2 + hauteur_box + espace_y;

    dessiner_rectangle_arrondi_creux(x1_carre, y3, x2_carre, y3 + hauteur_box, rayon_bord, epaisseur_bord, COLOR_BOX_BLUE);
    dessiner_icone_40x40(x1_carre - 2, y3 - 2, Uptime, WHITE);

    dessiner_rectangle_arrondi_creux(x1_rect, y3, x2_rect, y3 + hauteur_box, rayon_bord, epaisseur_bord, COLOR_BOX_BLUE);

    // on convertit les ms en h/m/s
    uint32_t uptime_s = to_ms_since_boot(get_absolute_time()) / 1000;
    uint32_t h = uptime_s / 3600;
    uint32_t m = (uptime_s % 3600) / 60;
    uint32_t s = uptime_s % 60;

    char str_h[10], str_m[10], str_s[10];
    sprintf(str_h, "%02lu", h);
    sprintf(str_m, "%02lu", m);
    sprintf(str_s, "%02lu", s);

    // calcul pour tout centrer proprement
    uint16_t w_h = strlen(str_h) * 14; 
    uint16_t w_m = 2 * 14;
    uint16_t w_s = 2 * 14;
    uint16_t w_lettre = 7;
    uint16_t w_espace = 6;

    uint16_t largeur_totale = w_h + w_lettre + w_espace + w_m + w_lettre + w_espace + w_s + w_lettre;

    uint16_t rect_width = x2_rect - x1_rect;
    uint16_t start_x_up = x1_rect + (rect_width - largeur_totale) / 2;

    uint16_t y_font20 = (y3 + (hauteur_box - 20) / 2) +2;
    uint16_t y_font12 = y_font20 + 8; 

    // affichage Heures
    Paint_DrawString_EN(start_x_up, y_font20, str_h, &Font20, BLACK, WHITE);
    start_x_up += w_h;
    Paint_DrawString_EN(start_x_up, y_font12, "h", &Font12, BLACK, WHITE);
    start_x_up += w_lettre + w_espace;

    // affichage Minutes
    Paint_DrawString_EN(start_x_up, y_font20, str_m, &Font20, BLACK, WHITE);
    start_x_up += w_m;
    Paint_DrawString_EN(start_x_up, y_font12, "m", &Font12, BLACK, WHITE);
    start_x_up += w_lettre + w_espace;

    // affichage Secondes
    Paint_DrawString_EN(start_x_up, y_font20, str_s, &Font20, BLACK, WHITE);
    start_x_up += w_s;
    Paint_DrawString_EN(start_x_up, y_font12, "s", &Font12, BLACK, WHITE);

    // bloc 4 : mesure de l'entropie

    uint16_t y4 = y3 + hauteur_box + espace_y;

    dessiner_rectangle_arrondi_creux(x1_carre, y4, x2_carre, y4 + hauteur_box, rayon_bord, epaisseur_bord, COLOR_BOX_PURPLE);
    dessiner_icone_40x40(x1_carre - 2, y4 - 2, Health, WHITE);

    dessiner_rectangle_arrondi_creux(x1_rect, y4, x2_rect, y4 + hauteur_box, rayon_bord, epaisseur_bord, COLOR_BOX_PURPLE);

    char texte_entropie[16];
    sprintf(texte_entropie, "%.5f", ui_entropie);

    // centrage du texte
    uint16_t rect_width2 = x2_rect - x1_rect;
    uint16_t text_width2 = strlen(texte_entropie) * 14;

    uint16_t start_x2 = x1_rect + (rect_width2 - text_width2) / 2;
    uint16_t start_y2 = (y4 + (hauteur_box - 20) / 2)+2;

    Paint_DrawString_EN(start_x2, start_y2, texte_entropie, &Font20, BLACK, WHITE);

    // icone des reglages en bas
    dessiner_icone_40x40(190, 235, Settings, WHITE);
}

void dessiner_page_reglages(UWORD *BlackImage) {
    dessiner_entete_settings(240, 280);

    Paint_DrawString_EN(10, 80, "Compression Ratio:", &Font16, BLACK, WHITE);

    // selection du ratio avec 4 boutons
    uint16_t x_coords[] = {20, 75, 130, 185};
    uint16_t ratios[] = {2, 4, 8, 16};
    uint16_t y_reg = 110;
    uint16_t w_reg = 45;
    uint16_t h_reg = 40;

    for (int i = 0; i < 4; i++) {
        bool is_active = (trng_ratio == ratios[i]);
        char text[3];
        sprintf(text, "%d", ratios[i]);

        uint16_t offset_x = (ratios[i] < 10) ? 17 : 11; 

        if (is_active) {
            // bouton actif : fond blanc, texte noir
            dessiner_rectangle_arrondi(x_coords[i], y_reg, x_coords[i] + w_reg, y_reg + h_reg, 5, WHITE);
            Paint_DrawString_EN(x_coords[i] + offset_x, y_reg + 12, text, &Font16, WHITE, BLACK);
        } else {
            // bouton inactif : contour gris
            dessiner_rectangle_arrondi_creux(x_coords[i], y_reg, x_coords[i] + w_reg, y_reg + h_reg, 5, 2, DARK_GRAY);
            Paint_DrawString_EN(x_coords[i] + offset_x, y_reg + 12, text, &Font16, BLACK, WHITE);
        }
    }

    uint16_t y_btn = 175;
    uint16_t h_btn = 35;

    // bouton reset
    dessiner_rectangle_arrondi_creux(20, y_btn, 115, y_btn + h_btn, 5, 2, COLOR_BOX_PINK);
    Paint_DrawString_EN(40, y_btn + 10, "RESET", &Font16, BLACK, WHITE);

    // bouton info
    dessiner_rectangle_arrondi_creux(125, y_btn, 220, y_btn + h_btn, 5, 2, COLOR_BOX_BLUE);
    Paint_DrawString_EN(145, y_btn + 10, "ABOUT", &Font16, BLACK, WHITE);

    // icone de retour
    dessiner_icone_40x40(15, 235, Arrow, WHITE);

    // gestion du mode nuit/veille
    if (always_on) {
        dessiner_icone_40x40(190, 235, Lunebarre, WHITE); 
    } else {
        dessiner_icone_40x40(190, 235, Lune, WHITE);
    }
}

void dessiner_page_about(UWORD *BlackImage) {
    dessiner_fond_grille(240, 280);

    Paint_DrawString_EN(70, 20, "ABOUT ME", &Font20, BLACK, WHITE);
    Paint_DrawString_EN(45, 55, "Firmware: v1.0", &Font16, BLACK, WHITE);
    Paint_DrawString_EN(45, 75, "0xEntropy.xyz", &Font16, BLACK, WHITE);

    dessiner_qrcode_100x100(70, 110, Qrcode);

    Paint_DrawString_EN(40, 250, "Tap anywhere to return", &Font12, BLACK, WHITE);
}

void dessiner_page_fatal(UWORD *BlackImage) {
    // ecran de la mort
    Paint_Clear(RED);

    Paint_DrawString_EN(10, 15, "!!! FATAL !!!", &Font24, RED, WHITE);

    Paint_DrawLine(20, 40, 220, 40, WHITE, DOT_PIXEL_1X1, LINE_STYLE_SOLID);

    Paint_DrawString_EN(8, 60, "TRNG SENSOR DEAD", &Font20, RED, WHITE);

    dessiner_qrcode_100x100(70, 100, Qrcodefatal);

    Paint_DrawString_EN(21, 230, "USB OUTPUT BLOCKED", &Font16, RED, WHITE);

    Paint_DrawString_EN(48, 260, "Press 1s to stop sound", &Font12, RED, WHITE);
}
